## Documentation/devicetree/bindings/gpio/gpio-dummy-cd.txt
```
* Amazon Dummy GPIO Controller
* This device emulates a card detect gpio for an mmc sdio card. This is useful in
* cases where platform does not have a spare gpio for card detection or the card
* itself is non-removable. It emulates a single gpio bank with a single line and
* an irq controller with a single irq assigned to the corresponding gpio.

Required properties:
-compatible : Should be "amazon,dummy_cd"
-emul-cd-gpio : some other gpio such as power gpio that can be used
		to detect card presence
- gpio-controller : Marks the device node as a gpio controller.
- #gpio-cells : Should be zero since we emulate just one dummy gpio
- interrupt-controller: Marks the device node as an interrupt controller.

Example:

gpio_cd: gpio-dummy-cd {
	compatible = "amazon,dummy_cd";
	/* Emulate dummy cd based on on/off gpio */
	emul-cd-gpio = <&gpio2 18 0>;
	gpio-controller;
	#gpio-cells = <0>;
	interrupt-controller;
};
```

## drivers/staging/amazon/Kconfig
```kconfig
menu "AMAZON"

config AMAZON
        bool "Amazon Drivers"
        default N
        ---help---
          Enable support for various drivers needed on the Amazon FireOS platform

if AMAZON

config IDME
        bool "IDME support"
        depends on PROC_FS
	default N
        help
          Select Y here to enable IDME support to read the data
          via userspace (i.e. /proc/idme/* entries)

config AMAZON_KLOG_CONSOLE
	bool "Amazon Kernel Log Console"
	depends on ANDROID_LOGGER
	default N
	help
          provide the kernel log console which will rewrite the kernel message to Android Logger buffer.

config AMAZON_SIGN_OF_LIFE
	bool "Amazon Sign of Life"
	help
          enable the life cycle metrics to log device boot and shutdown information

config AMAZON_SIGN_OF_LIFE_MTK
	bool "Amazon Sign of Life MTK platform implementation"
	help
          enable the life cycle metrics to log device boot and shutdown information on MTK Platform

config MDUMP
        bool "Generic memory dump"
        default n
        help
          The module allow support mdump feature, It need bootloader's support. when
          panic, it will do a mark, and bootloader can store all memory to analyze.

          If unsure, say N.

config MDUMP_COMPRESS
        bool "Compress memory dump"
        default n
        help
          The module supports compressed ramdump, which allows ramdump to be written
          to userdata partition instead of a dedicate DUMP partition.

          If unsure, say N.

config MDUMP_BUFFER_ADDRESS
        hex "MDUMP Memory Buffer Address"
        default 0x81FC0000
        depends on MDUMP
        help
          Set mdump buffer address for mdump module. This address will share with bootloader
          Make sure you also changed this value on bootloader config code

config MDUMP_MESSAGE_SIZE
        hex "MDUMP Memory Buffer Message Size"
        default 0x10000
        depends on MDUMP
        help
          Set mdump buffer size for mdump module. This size will share with bootloader
          Make sure you also changed this value on bootloader config code
          There are two stage messages. So mdump buffer's real size is MDUMP_MESSAGE_SIZE * 2

endif # if AMAZON

endmenu
```
